## drivers/backlight/ktd3136/Kconfig
```kconfig
config LEDS_KTD3136
	tristate "KTD3136 LED driver"
	default n
	help
	  Say Y here if you have KTD3136 LED in
	  your system.

	  If unsure, say N.

	  To compile this driver as a module, choose M here: the
	  module will be called ktd3136_bl.
```

## drivers/input/misc/fpc_fps_mmi/Kconfig
```kconfig
config FPC_FPS
	tristate "Fingerprint Cards Fingerprint Driver"
	default n
	help
	  Say Y here if you wish to include support for Fingerprint Cards (FPC) fingerprint sensor.

	  If unsure, say N.

	  To compile this driver as a module, choose M here: the module will be called fpc_mtk_tee.

config INPUT_MISC_FPC1020_SAVE_TO_CLASS_DEVICE
	bool "FPC save to class device"
	default n
	help
	  Say Y here if you wish to expose FPC sysfs under /sys/class/fingerprint/fpc_spi.

config FPC_SHARE_GPIO
	bool "FPC share GPIO"
	default n
	help
	  Say Y here if you wish to share GPIO for FPC fingerprint sensor.
```

## drivers/misc/utag/Kconfig
```kconfig
#
# UTAGS Driver
#

config MOTO_UTAGS
	tristate "Moto UTAGS driver"
	default n
	help
	  Say Y here if you have UTAGS
	  defined in your system.

	  If unsure, say N.

	  To compile this driver as a module, choose M here: the
	  module will be called utags.
```

## drivers/power/Kconfig
```kconfig
# SPDX-License-Identifier: GPL-2.0-only
source "drivers/power/reset/Kconfig"
source "drivers/power/supply/Kconfig"

comment "Motorola Power Drivers"

source "drivers/power/qpnp_adaptive_charge/Kconfig"

source "drivers/power/sc8551_mmi/Kconfig"
```

## drivers/power/sc8551_mmi/Kconfig
```kconfig
config SC8551_CHARGER
	tristate "SC8551 Charge Pump Driver"
	default n
	help
	  Say Y here if you have SC8551 Charging Device in
	  your system.

	  If unsure, say N.

	  To compile this driver as a module, choose M here: the
	  module will be called sc8551_mmi.
```
